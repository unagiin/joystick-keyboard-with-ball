## Kconfig
```kconfig
config ZMK_KSCAN_JOYSTICK
    bool "Analog stick as virtual kscan keys"
    default y
    depends on DT_HAS_ZMK_KSCAN_JOYSTICK_ENABLED
    select ADC
    select KSCAN

if ZMK_KSCAN_JOYSTICK

module = ZMK_KSCAN_JOYSTICK
module-str = zmk_kscan_joystick
source "subsys/logging/Kconfig.template.log_config"

endif

config JOYBALL42_STICK_PROBE
    bool "Temporary stick pin-out probe"
    default y
    depends on SHIELD_STICK_PROBE
```

## boards/shields/stick_probe/Kconfig.defconfig
```kconfig
# SPDX-License-Identifier: MIT

if SHIELD_STICK_PROBE

config ZMK_KEYBOARD_NAME
    default "Stick Probe"

endif
```
